## Documentation/devicetree/bindings/display/panel/fpt,ttcm03921235.yaml
```yaml
# SPDX-License-Identifier: (GPL-2.0-only OR BSD-2-Clause)
%YAML 1.2
---
$id: http://devicetree.org/schemas/display/panel/fpt,ttcm03921235.yaml#
$schema: http://devicetree.org/meta-schemas/core.yaml#

title: FPT TTCM03921235 AMOLED panel

maintainers:
  - marvin <marvin@bvio.ai>

description: |
  The FPT TTCM03921235 is a 1080x1240 four-lane MIPI-DSI AMOLED
  module using a factory-programmed Chip Wealth CH13726A controller.

allOf:
  - $ref: panel-common.yaml#

properties:
  compatible:
    const: fpt,ttcm03921235

  reg:
    maxItems: 1

  power-supply:
    description: 3.0 V VCI panel supply

  reset-gpios:
    maxItems: 1
    description: Active-low panel reset

  fpt,bootloader-initialized:
    type: boolean
    description: |
      The bootloader has already powered and initialized the panel and is
      displaying a logo. The driver preserves that state across the Linux
      display handoff and performs the full sequence after the first power
      cycle.

  ports:
    $ref: /schemas/graph.yaml#/properties/ports

required:
  - compatible
  - reg
  - power-supply
  - reset-gpios
  - ports

additionalProperties: false

examples:
  - |
    dsi {
        #address-cells = <1>;
        #size-cells = <0>;

        panel@0 {
            compatible = "fpt,ttcm03921235";
            reg = <0>;
            power-supply = <&lcd_vci>;
            reset-gpios = <&gpio3 4 1>;
            fpt,bootloader-initialized;

            ports {
                #address-cells = <1>;
                #size-cells = <0>;

                port@0 {
                    reg = <0>;

                    panel_in: endpoint {
                        remote-endpoint = <&dsi_out>;
                    };
                };
            };
        };
    };
...
```

## Documentation/devicetree/bindings/sound/everest,es8389.yaml
```yaml
# SPDX-License-Identifier: (GPL-2.0-only OR BSD-2-Clause)
%YAML 1.2
---
$id: http://devicetree.org/schemas/sound/everest,es8389.yaml#
$schema: http://devicetree.org/meta-schemas/core.yaml#

title: Everest ES8389 and ES8390 audio CODECs

description: |
  The ES8390 uses the ES8389 register and digital-audio interface and is
  controlled by the same driver.  Boards containing an ES8390 therefore use
  the everest,es8389 compatible string.

maintainers:
  - Michael Zhang <zhangyi@everest-semi.com>

allOf:
  - $ref: dai-common.yaml#

properties:
  compatible:
    const: everest,es8389

  reg:
    maxItems: 1

  clocks:
    items:
      - description: clock for master clock (MCLK)

  clock-names:
    items:
      - const: mclk

  port:
    $ref: audio-graph-port.yaml#
    unevaluatedProperties: false

  "#sound-dai-cells":
    const: 0

  vdda-supply:
    description:
      Analogue power supply.

  vddd-supply:
    description:
      Interface power supply.

  everest,mclk-src:
    $ref: /schemas/types.yaml#/definitions/uint32
    minimum: 0
    maximum: 1
    description:
      Master-clock source selector.  Zero selects the MCLK pin and one selects
      the serial bit-clock pin.

  everest,adc-slot:
    $ref: /schemas/types.yaml#/definitions/uint32
    minimum: 0
    maximum: 7
    description: ADC TDM slot number.

  everest,dac-slot:
    $ref: /schemas/types.yaml#/definitions/uint32
    minimum: 0
    maximum: 7
    description: DAC TDM slot number.

  everest,dmic-enabled:
    type: boolean
    description: Use the digital microphone input instead of the analogue input.

  everest,invert-right-output:
    type: boolean
    description:
      Invert the right DAC output polarity.  This is used by boards that feed
      a differential mono power amplifier from LOUT2 and ROUT2.

  everest,speaker-feedback-capture:
    type: boolean
    description:
      Route both ADC PGA inputs to LIN2/RIN2 so that the differential speaker
      output fed back into those pins is captured instead of the microphones.
      This only sets the power-on default; the "Speaker Feedback Capture
      Switch" mixer control selects the source at runtime.

  everest,dac-playback-volume:
    $ref: /schemas/types.yaml#/definitions/uint32
    minimum: 0
    maximum: 255
    description: |
      Initial left and right DAC digital playback volume.  Each step is 0.5 dB
      starting at -95.5 dB; value 191 is 0 dB.  The value is restored after
      codec initialization and resume.

required:
  - compatible
  - reg
  - "#sound-dai-cells"
  - vddd-supply
  - vdda-supply

additionalProperties: false

examples:
  - |
    i2c {
      #address-cells = <1>;
      #size-cells = <0>;
      es8389: codec@10 {
        compatible = "everest,es8389";
        reg = <0x10>;
        #sound-dai-cells = <0>;
        vddd-supply = <&vdd3v3>;
        vdda-supply = <&vdd3v3>;
        everest,dac-playback-volume = <179>;
      };
    };
```

## drivers/input/touchscreen/focaltech_touch_ft3519/Kconfig
```kconfig
#
# Focaltech Touchscreen driver configuration
#

config TOUCHSCREEN_FT3519
	tristate "FocalTech FT3519 touchscreen"
	depends on I2C
	help
	  Vendor driver for the FT3519 controller.
```

## drivers/tee/optee/Kconfig
```kconfig
# SPDX-License-Identifier: GPL-2.0-only
# OP-TEE Trusted Execution Environment Configuration
config OPTEE
	tristate "OP-TEE"
	depends on HAVE_ARM_SMCCC
	depends on MMU
	help
	  This implements the OP-TEE Trusted Execution Environment (TEE)
	  driver.

config VIOLOOP_OEM_OTP_WRITE_GUARD
	bool "Violoop OEM OTP factory completion write guard"
	depends on ARCH_ROCKCHIP && OPTEE=y
	help
	  Reject Rockchip OEM OTP writes after OEM byte 0 bit 0 is set.
	  Read failures also reject writes. OEM reads remain available.
```
