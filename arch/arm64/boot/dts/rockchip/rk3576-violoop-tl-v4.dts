// SPDX-License-Identifier: (GPL-2.0+ OR MIT)
/*
 * Violoop TL V4 hardware with the Rockchip minimal Debian userspace scheme.
 */

/dts-v1/;

#include "rk3576.dtsi"
#include "rk3576-linux.dtsi"
#include "violoop/tl-v4/rk3576-violoop-tl-v4-base.dtsi"
#include "violoop/tl-v4/rk3576-violoop-tl-v4-panel-fpt-ttcm03921235.dtsi"
#include "violoop/tl-v4/rk3576-violoop-tl-v4-board.dtsi"
#include "violoop/tl-v4/rk3576-violoop-tl-v4-rk1828.dtsi"
#include "violoop/tl-v4/rk3576-violoop-tl-v4-peripherals.dtsi"

/ {
	model = "Violoop RK3576 TL V4 Minimal Debian";
	compatible = "violoop,rk3576-tl-v4", "rockchip,rk3576";
};
